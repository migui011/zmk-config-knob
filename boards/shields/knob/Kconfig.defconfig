## boards/shields/knob/Kconfig.defconfig
```kconfig
if SHIELD_KNOB_DONGLE

config ZMK_KEYBOARD_NAME
    default "Knob"

config ZMK_SPLIT_ROLE_CENTRAL
    default y

endif

if SHIELD_KNOB_DONGLE || SHIELD_KNOB_LEFT || SHIELD_KNOB_RIGHT

config ZMK_SPLIT
    default y
	
config ZMK_SPLIT_BLE_CENTRAL_PERIPHERALS
    default 2

endif
```

## boards/shields/knob/Kconfig.shield
```kconfig
# Copyright (c) 2020 Pete Johanson
# SPDX-License-Identifier: MIT

config SHIELD_KNOB_LEFT
    def_bool $(shields_list_contains,knob_left)

config SHIELD_KNOB_RIGHT
    def_bool $(shields_list_contains,knob_right)

config SHIELD_KNOB_DONGLE 
	def_bool $(shields_list_contains,knob_dongle)
```
